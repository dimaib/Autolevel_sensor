#include "main.h"

unsigned int rezero(){								//выставление/пересчёт нуля
	char buf[20];									//буфер для вывода сообщения
	unsigned long sum_zero=0;						//переменная для суммирования
	for(int i=0;i<IZM_NUM;i++){
		sum_zero+=getadc(TENZ);
		_delay_ms(10);
	}
	sum_zero/=IZM_NUM;
	sprintf(buf,"Zero=%ld\r\n",sum_zero);
	print_w(buf);
	return (int)sum_zero;
}

void set_rez(uint8_t res_om, uint8_t num)			//установка значения сопративления потанциометра. 0 - gain, 1 - ref
{
	RES_CLK;
	if(num==REF_NUM) RES_CS_ref; else RES_CS_gain;	//включаем SPI шину потанцеометра
	for(int ii=0;ii<8;ii++){						//цикл для разложения бита со значением сопративления
		SET_CLK;									//установка в единицу пина тактирования потанциометра
		if(res_om&(128>>ii)) SET_SDI; else RES_SDI;	//сканирование байта начиная со старшего бита. Если бит равен единице, то выставляем SDI в единицу, иначе сбрасываем
		RES_CLK;									//сброс пина тактирования потанциометра
	}
	SET_CLK;										//останавливаем SPI шину потанцеометра
	if(num==REF_NUM) SET_CS_ref; else SET_CS_gain;	//включаем SPI шину потанцеометра
}

void auto_tuning()									//автоматическая подстройка усиления и опорного напряжения для INA333
{
	unsigned int tenz_real=0;						//переменная для считывания в неё АЦП
	set_rez(0,0);									//инициализация усиления (0)
	set_rez(0,1);									//инициализация опорного напряжения (0)
	for (uint8_t g=0;g<240;g+=25){					//цикл автоматической подстройки усиления INA333
		set_rez(g,0);								//посылаем текущую настройку усиления в потенциометр
		for(uint8_t r=0;r<255;r++){					//цикл для автоматической подстройки опорного напряжения для INA333
			set_rez(r,1);							//посылаем текущую настройку опорного напряжения в потенциометр
			tenz_real=getadc(TENZ);					//чтение значения АЦП тензорезистора
			if(tenz_real>MIN_ADC && tenz_real<MAX_ADC){//если данные значения подстройки подходят, то вылетаем из цикла
				ref=r;
				break;
			}
			TOGGLE_LED;								//мигаем светодиодом во время подстройки
		}
		if(tenz_real>MIN_ADC && tenz_real<MAX_ADC){	//если данные значения подстройки подходят, то вылетаем из цикла
				gain=g;
				break;
			}
		}
}

void init_sys(){									//начальная инициализация
	/*инициализация портов*/
	DDRC=(1<<0);									//0 - Led на выход 
	DDRD=(1<<2)|(1<<5)|(1<<6);						//2 - Rel, 5 - CS_ref, 6 - CS_gain на выход
	DDRB=(1<<6)|(1<<7);								//6 - SDI, 7 - SCK на выход
	/*инициализация портов*/
	adc_init();										//инициализация ADC
	init_UART();									//инициализация UART
	auto_tuning();									//автоматическая подстройка INA333
	print_w("Start...\r\n");						//сообщение об успешном старте контроллера
	_delay_ms(200);									//задержка для завершения первого измерения для двух каналов
	/*начальный подсчёт среднего значения порога*/

	/*начальный подсчёт среднего значения порога*/
}